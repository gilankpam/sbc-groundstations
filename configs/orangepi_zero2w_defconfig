## configs/orangepi_zero2w_defconfig
```kconfig
BR2_aarch64=y
BR2_cortex_a53=y
BR2_CCACHE=y
BR2_TOOLCHAIN_EXTERNAL=y
BR2_PACKAGE_OVERRIDE_FILE="${BR2_EXTERNAL_OPENIPC_SBC_GS_PATH}/board/orangepi/zero2w/local.mk"
BR2_TARGET_GENERIC_HOSTNAME="openipcgs"
BR2_TARGET_GENERIC_ISSUE="Welcome to OpenIPC GS"
BR2_ROOTFS_DEVICE_CREATION_DYNAMIC_EUDEV=y
BR2_TARGET_GENERIC_ROOT_PASSWD="12345"
BR2_TARGET_GENERIC_PASSWD_SHA512=y
# BR2_TARGET_GENERIC_REMOUNT_ROOTFS_RW is not set
BR2_ENABLE_LOCALE_WHITELIST="C en_US en_US.UTF-8"
BR2_GENERATE_LOCALE="C.UTF-8 en_US.UTF-8"
BR2_ROOTFS_OVERLAY="${BR2_EXTERNAL_OPENIPC_SBC_GS_PATH}/board/common/overlay ${BR2_EXTERNAL_OPENIPC_SBC_GS_PATH}/board/orangepi/zero2w/overlay ${BR2_EXTERNAL_OPENIPC_SBC_GS_PATH}/board/local/overlay"
BR2_ROOTFS_POST_BUILD_SCRIPT="${BR2_EXTERNAL_OPENIPC_SBC_GS_PATH}/board/common/post-build-script.sh"
BR2_ROOTFS_POST_IMAGE_SCRIPT="support/scripts/genimage.sh ${BR2_EXTERNAL_OPENIPC_SBC_GS_PATH}/board/common/gen-boot-scr.sh"
BR2_ROOTFS_POST_SCRIPT_ARGS="-c ${BR2_EXTERNAL}/board/orangepi/zero2w/genimage.cfg"
BR2_LINUX_KERNEL=y
BR2_LINUX_KERNEL_CUSTOM_VERSION=y
BR2_LINUX_KERNEL_CUSTOM_VERSION_VALUE="6.18.35"
BR2_GLOBAL_PATCH_DIR="${BR2_EXTERNAL_OPENIPC_SBC_GS_PATH}/board/orangepi/zero2w/patches"
BR2_LINUX_KERNEL_USE_CUSTOM_CONFIG=y
BR2_LINUX_KERNEL_CUSTOM_CONFIG_FILE="${BR2_EXTERNAL_OPENIPC_SBC_GS_PATH}/board/orangepi/zero2w/linux.config"
BR2_LINUX_KERNEL_DTS_SUPPORT=y
BR2_LINUX_KERNEL_INTREE_DTS_NAME="allwinner/sun50i-h618-orangepi-zero2w"
BR2_LINUX_KERNEL_DTB_KEEP_DIRNAME=y
BR2_LINUX_KERNEL_INSTALL_TARGET=y
BR2_PACKAGE_BUSYBOX_CONFIG="${BR2_EXTERNAL}/package/busybox/busybox.config"
BR2_PACKAGE_BUSYBOX_SHOW_OTHERS=y
BR2_PACKAGE_DOSFSTOOLS=y
BR2_PACKAGE_DOSFSTOOLS_MKFS_FAT=y
BR2_PACKAGE_E2FSPROGS=y
BR2_PACKAGE_E2FSPROGS_RESIZE2FS=y
BR2_PACKAGE_LINUX_FIRMWARE=y
BR2_PACKAGE_PARTED=y
BR2_PACKAGE_UBOOT_TOOLS=y
BR2_PACKAGE_LIBDRM=y
BR2_PACKAGE_LIBDRM_INSTALL_TESTS=y
BR2_PACKAGE_DROPBEAR=y
BR2_PACKAGE_IPROUTE2=y
BR2_PACKAGE_IW=y
BR2_PACKAGE_OPENSSH=y
BR2_PACKAGE_WPA_SUPPLICANT=y
BR2_PACKAGE_WPA_SUPPLICANT_AP_SUPPORT=y
BR2_PACKAGE_DNSMASQ=y
# --- Task 6: wfb FPV link stack (stock wifibroadcast-ng, no fpvd) ---
BR2_PACKAGE_PYTHON3=y
BR2_PACKAGE_PYTHON3_BZIP2=y
BR2_PACKAGE_PYTHON3_CURSES=y
BR2_PACKAGE_PYTHON_BABEL=y
BR2_PACKAGE_PYTHON_FLASK=y
BR2_PACKAGE_PYTHON_TWISTED=y
BR2_PACKAGE_PYTHON_MSGPACK=y
BR2_PACKAGE_PYTHON_PYROUTE2=y
BR2_PACKAGE_PYTHON_PYYAML=y
BR2_PACKAGE_PYTHON_SERIAL=y
BR2_PACKAGE_WIRELESS_REGDB=y
BR2_PACKAGE_WIFIBROADCAST_NG=y
BR2_PACKAGE_WFB_SERVER=y
BR2_PACKAGE_RTL8812AU=y
# rtl88x2eu/cu build clean on kernel 6.18 now that their bundled SHA256 APIs are
# rtw_-prefixed (6.18 added a built-in hmac_sha256 to lib/crypto that the old
# name collides with). Both carry the rename upstream in their pinned forks.
BR2_PACKAGE_RTL88X2EU=y
BR2_PACKAGE_RTL88X2CU=y
BR2_PACKAGE_KMOD_TOOLS=y
BR2_PACKAGE_UTIL_LINUX_AGETTY=y
BR2_TARGET_ROOTFS_SQUASHFS=y
BR2_TARGET_ROOTFS_SQUASHFS4_ZSTD=y
# BR2_TARGET_ROOTFS_TAR is not set
BR2_TARGET_UBOOT=y
BR2_TARGET_UBOOT_BOARD_DEFCONFIG=y
BR2_TARGET_UBOOT_BOARD_DEFCONFIG="orangepi_zero2w"
BR2_TARGET_UBOOT_CONFIG_FRAGMENT_FILES="${BR2_EXTERNAL_OPENIPC_SBC_GS_PATH}/board/orangepi/zero2w/uboot.fragment"
BR2_TARGET_UBOOT_FORMAT_CUSTOM=y
BR2_TARGET_UBOOT_FORMAT_CUSTOM_NAME="u-boot-sunxi-with-spl.bin"
BR2_TARGET_UBOOT_NEEDS_DTC=y
BR2_TARGET_UBOOT_NEEDS_PYLIBFDT=y
BR2_TARGET_UBOOT_NEEDS_PYELFTOOLS=y
BR2_TARGET_UBOOT_NEEDS_OPENSSL=y
BR2_TARGET_UBOOT_NEEDS_GNUTLS=y
BR2_TARGET_UBOOT_NEEDS_ATF_BL31=y
BR2_TARGET_ARM_TRUSTED_FIRMWARE=y
BR2_TARGET_ARM_TRUSTED_FIRMWARE_LATEST_VERSION=y
BR2_TARGET_ARM_TRUSTED_FIRMWARE_PLATFORM="sun50i_h616"
BR2_TARGET_ARM_TRUSTED_FIRMWARE_BL31=y
BR2_PACKAGE_HOST_E2FSPROGS=y
BR2_PACKAGE_HOST_GENIMAGE=y
BR2_PACKAGE_HOST_UBOOT_TOOLS=y
BR2_PACKAGE_HOST_SWIG=y
# ffmpeg 7.1 from jernejsk/FFmpeg @ v4l2-request-n7.1 (7.1 + V4L2-Request hwaccel
# for Cedrus) — a standalone package (core ffmpeg is 6.1.3, no v4l2-request, and
# its patches do not apply to 7.1). Stages libav* for the wfbvid player + the
# ffmpeg CLI for smoke tests; carries the prefer-linear-NV12 capture patch.
BR2_PACKAGE_FFMPEG_V4L2REQUEST=y
# citruspilot: the sunxi/Cedrus FPV player (RTP -> HW decode -> DE33 plane).
# Listens on udp:5600 where wfb gs_video forwards the de-FEC'd H.265; ships an
# S99 launch chain. orangepi-only (no other defconfig enables it).
BR2_PACKAGE_CITRUSPILOT=y
```

## package/citruspilot/Config.in
```kconfig
config BR2_PACKAGE_CITRUSPILOT
	bool "citruspilot"
	depends on BR2_PACKAGE_HAS_UDEV
	select BR2_PACKAGE_FFMPEG_V4L2REQUEST
	select BR2_PACKAGE_LIBDRM
	help
	  Low-latency FPV video player for the Orange Pi Zero 2W (Allwinner
	  H618): take the drone's H.265 off the wfb-ng link (de-FEC'd RTP on a
	  local UDP port), hardware-decode on Cedrus, and scan direct-to-plane
	  on the DE33 display engine. The sunxi analog of PixelPilot_rk.

	  Player only -- it consumes the RTP that an external wfb_rx forwards
	  to udp:5600. Requires the v4l2request-patched ffmpeg
	  (ffmpeg-v4l2request) and the patched mainline kernel (NV12 on the
	  DE33 VI plane).

	  https://github.com/gilankpam/citruspilot
```

## package/ffmpeg-v4l2request/Config.in
```kconfig
config BR2_PACKAGE_FFMPEG_V4L2REQUEST
	bool "ffmpeg-v4l2request"
	depends on BR2_PACKAGE_HAS_UDEV
	select BR2_PACKAGE_LIBDRM
	select BR2_PACKAGE_ZLIB
	help
	  FFmpeg 7.1 (jernejsk/FFmpeg @ v4l2-request-n7.1) with the out-of-tree
	  V4L2 Request API hwaccel for Cedrus (Allwinner H618) hardware HEVC
	  decode. Carries the prefer-linear-NV12 capture-format patch so the
	  decoder exports frames the H618 DE33 display planes can scan out.

	  Replaces Buildroot's core ffmpeg package (6.1.3, no
	  --enable-v4l2-request). Nothing else in this tree depends on ffmpeg;
	  it only stages libav* for the externally-built wfbvid player and
	  provides the ffmpeg CLI used by the smoke tests.

	  https://github.com/jernejsk/FFmpeg/tree/v4l2-request-n7.1
```

## package/fpvd/Config.in
```kconfig
config BR2_PACKAGE_FPVD
	bool "fpvd"
	depends on BR2_PACKAGE_PYTHON3
	depends on BR2_PACKAGE_WFB_SERVER
	depends on BR2_PACKAGE_WIFIBROADCAST_NG
	help
	  fpvd ground-station supervisor (Python). Owns the wfb data plane
	  in-process via the wfb_ng library, spawns and supervises the
	  pixelpilot display process, and serves the GS HTTP API on :8080.

	  Enabling fpvd retires wifibroadcast-ng's stock S98wifibroadcast
	  launcher; fpvd brings up wfb_rx/wfb_tx itself.
```

## package/go2rtc/Config.in
```kconfig
config BR2_PACKAGE_GO2RTC
	bool "go2rtc"
	depends on BR2_PACKAGE_GSTREAMER1
	help
	  Ultimate camera streaming application with support RTSP, RTMP, HTTP-FLV, WebRTC, MSE, HLS, MP4, MJPEG, HomeKit, FFmpeg, etc.

	  https://github.com/AlexxIT/go2rtc
```

## package/gstreamer-tee/Config.in
```kconfig
config BR2_PACKAGE_GSTREAMER_TEE
	bool "gstreamer-tee"
	depends on BR2_PACKAGE_GSTREAMER1
	help
	  A gstreamer pipeline that tees a udp stream to two different ports.
```

## package/openipc-gs-web/Config.in
```kconfig
config BR2_PACKAGE_OPENIPC_GS_WEB
	bool "openipc-gs-web"
	depends on BR2_PACKAGE_HOST_GO_TARGET_ARCH_SUPPORTS
	depends on BR2_PACKAGE_HOST_GO_TARGET_CGO_LINKING_SUPPORTS
	depends on BR2_TOOLCHAIN_HAS_THREADS
	help
	  OpenIPC Web Based Ground Station.

	  https://github.com/gilankpam/openipc-gs-web
```
